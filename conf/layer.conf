## conf/layer.conf
```bitbake
# We have a conf and classes directory, add to BBPATH
BBPATH .= ":${LAYERDIR}"

# We have recipes-* directories, add to BBFILES
BBFILES += "${LAYERDIR}/recipes-*/*/*.bb ${LAYERDIR}/recipes-*/*/*.bbappend"

BBFILE_COLLECTIONS += "pjdrones"
BBFILE_PATTERN_pjdrones = "^${LAYERDIR}/"
BBFILE_PRIORITY_pjdrones = "1"

# This should only be incremented on significant changes that will
# cause compatibility issues with other layers
LAYERVERSION_pjdrones = "1"

LAYERDEPENDS_pjdrones = "core"

LAYERSERIES_COMPAT_pjdrones = "zeus"
```
